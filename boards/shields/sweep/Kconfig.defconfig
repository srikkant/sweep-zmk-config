## boards/shields/sweep/Kconfig.defconfig
```kconfig
if SHIELD_SWEEP_DONGLE || SHIELD_SWEEP_LEFT || SHIELD_SWEEP_RIGHT

config ZMK_SPLIT
	default y

endif

if SHIELD_SWEEP_DONGLE

config ZMK_KEYBOARD_NAME
	default "srikkant Sweep"

config ZMK_SPLIT_ROLE_CENTRAL
	default y

config CONFIG_ZMK_SPLIT_BLE_CENTRAL_PERIPHERALS
	default 2

endif
```

## boards/shields/sweep_left/Kconfig.defconfig
```kconfig
if SHIELD_SWEEP_LEFT || SHIELD_SWEEP_RIGHT

config ZMK_SPLIT
    default y

endif
```

## boards/shields/sweep_right/Kconfig.defconfig
```kconfig
if SHIELD_SWEEP_PERIPHERAL_LEFT || SHIELD_SWEEP_PERIPHERAL_RIGHT

config ZMK_SPLIT
    default y

endif
```
